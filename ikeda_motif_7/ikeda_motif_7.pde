/*  lit le code génétique, par segment de 8 lettres
    et recommence (la lecture du segment) jusqu'à la fin de l'image
    - change de segment, complete une image...
    - _4: change de motif à chaque image
    jusqu'à la fin du code génétique, puis change le motif et recommence la lecture
    
    -  possibilité de changer le nombre de bandes horizontales (avec le meme motif/ou different + meme echantillon)
    
    une image =1 segment de 8 lettres
    une image = un nouveau motif
*/
String DP5 = "CTTAATGCATTGACAGCCAAACTCATGTCTCCCTGTTCCTCAGCCCATGCTTCCTCTTCCACTCCTTCTTCTGATTGGCTCCTCACCTCCGTTCTCACTGCATTGTTCAGACTCCTGTCATTTGTGGCCAGGATTATTGCAGTAGCCTTCAAAATGATCTTCCTGCTCTGTTCTCATCCCTTCTGATTCATAGTCCATACTGTCACTGATGTTTCCAGATGCAGATCTGATCAGCCACTCCTTCCCACATGTAACCCTTTCATGGCTCTTCATGGCTATAGTGCTGATCATCACCCAGCTCCTCCCTGTGGTTGTATCTTCACCTGCCTCCTCTTCCACATGGTACTGCAGGTGGAAAGAGCGCAGGCTCCAGGATCTTAGGACATGAGGCCTGACTCCACCTCATGAGCAGTGAAGCCCTCAGGCCAGTTACTACACTAATTTCTGGGTATCTCAGTGTCTTTATCATGAAGAGATTGAATTTTTTTTTTTTCTTTTTTGAGGAAGAGACTCACTCTGTCTCCCAGGCTGGAGTGCAGTGGTGCGATCTCAGCTCTCTGCAACCTCTGCCTCCCGGGTTCAAGCAATTCCCCTGCCTCAGCCTCCCAAGTAGCTGGGATTACAGGTGTGTACTACCACCCCCAGCTAATTTTTGTATTTTTAGTAGAGATGGAGTCTTGCCATGTTGGGCAGTCTGGTCTCAAACTACTGGCCTCCTGTGATCTGCCCATCTCAGCCTCCCAAAGTGCTGGGATTACAGGCATGAGCCACCACACCTGGCTGGAGATTGACTATTAAATGTGATAATCCACATAAATTCTTAGGACAGTGCTGGACATCCATGGTGAGCACTCAACAAATAGGAGCTGTTGTTGTCATTACAATAACATATTTTGTATTCCAGGCATTTCTTGTGCTCCTCAAAAGAACTGTGTCCTCGTGTTCCTTTGCATAGATAGGTTCCTCTCTATAGAATATGCTTCTTCCCTGTCTTTAACCCCTGATTCTGACTGGCAGGCATGAACTTAGTTTATTATTCAGCTGCAACAATACCTCTTCTTTGAAGCCTGCCCCGGTGGTTCCCCCTCCTTCCCATGCCCTCCCGGGGTGTGTTAGGCATGTTTCCGCACAGCTCCGTATGCATAACCCAATTGTACAACTTGGCATGTTGTGATCTCACTGCTTGTTTTCCATGTCTGTCTCCTCACTAGACTGAAAGAGCTTATCTTTATTCATTTTCTCCACTCAATGTTTAACACATTTATGGACAAATGAATTTATATTTCCAAGACCAAGTTGCCGTATGTGAGAAGAATTTGAATAACACACAATATTATTATTTAATTGGTATGCAAGTATTTAATTATACATAGTTTTTTTTTTTTTTTTTAAGAGACAGGATCTTCCTCTGTTGTCCAGGATAGAGTACAGTGGCTTGATCTCACTGCAGCCTCAACCTTTTGGGATGATGTGATCCTTTCACCTCAGCATCCCAAATAGTTGGGACTACAGGCACATACCACCACACCTGGCTTAATTATATACGTATGCTCTGAATGCTTGGCTTCTCATAGATGGTGTGGGATCCTGGGGTTGTTTTTCTAGTCAGGGTGATATTGTTAAGTGGGGTCATCTTTTCCCTTTCCCAGTCCCTTTATGTAACCTATAGCATGTGTTTTCAAAGGGGTTAGTGGCCATCAAGAGGTGATCTATAGCCACATGGGAACTGAACTCCCATCTTTGACCTTAAGCTACCTGATCAATTATGTTAATGAGCCACTGAAAGAAATTAGATAAAATTATTCAAATTTTTATAACCATATATCGGACATTAATTTGTTATAACCATATGCAAAACCAATTAATGTCAGATCTTCAGGATATATCCATAGTCTTACTTCCATCAGTCTTAGCCTGGCCTAAGGTGCCATCATCTTTTGCCTGGATGCAGTAGCGAGTTACCTGGTCTTGGGCTCCTCCCTTGCCCTTCCATATCGTTTATTTTCAACACAACAAATCAGAGTGACCTTTATAAAATAGAATTTGGATTATGAACTTCTCTGCACAAAATTTTCCAAGGGCTTCCCAGCTCACTTGGAGTAAAAGCCAAGGCATTATGGTGGCAGATAGACCCCTCATGTCATGTGGCTGCTTGTTACGCTCAGTCCTCGTCTCCTGCTTTCTCCCTCTCATTTCACTCTGGAGGTTCCCCAGATAGATCAGGCTCACTCTGAATTGCAGGTCCTTCCTCTTGTTCGCCCCTCTGCTGTGCCTTTACTCCAGAGAGCATCATGGCTAAGATCCAGATGTCTGCATTTGCCCAAGACAGTCCTGGTTTGAATTTGTGAACCCATATGACTATTAATAGTGTCCCCTTCCAGTCTCAGAGGTGTCCTGTATTGGATGATAAATGACATGGCCACCCTTCCCACAGCTCGCTCTCTCGCTTCCTTCAGGTCTTGCCTGAATTGCCATATTTTACTTCAGCACTCCCCTCCTATCCTCTCTACCTAATATTTCTCCATTGTGCCACCTGGCATGCTAGATTTTTAAATTTTGTACTTTTTTTATTGTAAGTTCCATGACTGTCAGGATTTTTGTTTTGCTCATGACTGTATTCCCAGAGCTTAAAACAGTTCCTGGTGGCTGGGCACAGTGGCTCACGCCTGTAATCCCAGCACTTTGGGAGGCCAAGGCGGGCGGATCACCTGAGGTCGGGAGTTCGAGACCAGCCTGACCAACATGGAGAAACCGCCATCTCTGCTAAAAATACAAAATTAGCCAGGCGTGGTGGCGCATGCCTGTAATCCCAGCTACTTGGGAGGCTGAGGCAGGAGAATCGCTTTGAACCCGGGAGGCGGAGGTTGCAGTGAGCCAAGGTCACGCCATTGCACTCCAGCCTAGGCAACAAGAGCAAAACTCCGTCTCAAAAAAAAAAAAAAAAAAAAAACAGTTCCTGGCACATAATAGATAGTTGAATGAATGCTAAAAATCTTCTGAAGTTAGCTTTCTCTCTACTGAAGCATGATTTAATTTTTCTCTAATGCTTTTCTTTCTTATAACCTTCTTAAACAATTAACTAGATTCCTTTTTTTCAAAGACTTGGGTAGTCTTTTTCTCCTTGCTTGGTTTTTAAGTGACTTTCCTTTCAAGCCATCCTCAGTTTTCATGGAACATGTTTTGCCTTCTTCAAACTCACTAAACTCTTACCCATTCGAGAAAAGTGTATTGAACTCTAGGCACTGTGCTAAGGCCTGAGAAGAAACAAAAACTACTAAGACACTGACTCTCCCGACCTCAAGGAGCTCTGCTTCCTCATGCACTTGGGATTCTCTTTCAAGCAATTCCCATGTGGGGTAATGACGATGAAAGGAAAGCCGTCTTGTGGGGGATTGAACTGTGAATGGTTTCAGTGTGGTTTGAACATGTGATCTCTGCTAAATGAGGATGTGCTAGATGAGGGAGTGTGCTGTGATGAAAACAACCAGGATCAGAATTCCCCCTGCCCCTCACTGGACTTTCAAGCTGAGGCTCAGGTTCTTCATCTGTGTAATGGGCATAAAGATCCTCCCCTTCCTGACTGCCTGTCCCACAGAGCGGTTGTCTGGATCAAAAGTAGGTTGGGTACATTATGGGCTAGATTACCACATAGAGTCCTTGTTTTGGGACAAGGTGGGGTCTGAATTCACAACTGGTTAACATTTCATTCATTAAAAAATCAGAGAAGACTGGCGCGGTGTCTGACGCCTGTAATCCCAGCACTTTGGGAGGCCAAGGCGGGTGGATCACTTGAAGTCAGGAGTTCGAGACCAGCCTGACCAACATGTTGAAACCCCGCCTCTACTGAAAATACAAATATTAGCTGGGCGTGGTGGCGGGCGCCTGTAATCCCAGCGACTTGGGAGGCTGAGGCAGGAGAATCGCTTGAACCCGGGAGGTGGAGGTTGCAGTGAGCCAAGATCATGCCATTGCACTCCAGCCAGGGTGATAAGAGTGAAACTCCATCCCAGGGGAAAAAAAAAATCAGAGAAAAATCCAAACAGAGAAACCTTATCTGTGACCCTACCTTCACCTCTTTGCACCATCTGCAGGCACTCAAGCGTGACTCAGTCTTTCTCCTGCATTTGGACATGATTCATATGTGAATCATGATTCACAGGAGTATCATCTCTGTGGGTTTCCCTCCCAGCCCCACAGAATTTCATTTGGAGTGTTGTTGGTGGGGACCTGGTAGCTGCAGTCTTCACTTGTTTTTCACCCTGCTGCCCAGCAGAGACAGGGCAGTTGGTGTGACTGGGCAGATAGTTTTTATCCCTCTGTATCTTTAACTGGGCACCATTTTAGAAGACTTGCTAGTAAATGTCTTCCTTTATTGGAGTTAAATCATTTTGAAAAAGAAAATAAGTGGATGCCATGTTTTCTTTCTCTTTAGTGTTGAGGCTTAGAATCTGCAACTTGATATTTGTGTTGAATATTAGGTGCATGCAGTATATTTGGCCTGAGAGCCAAAGTAAAAGTAACTCATAGCATACTGAGACTGGATGGAAGGACCTCCGTCATTTCTCCAGGCCAGGTCAGTTTTTTTTATGGGTAAGTGCTGCCTCTGTAGCCCAGAGAAGAGAAACCACTTGCCCCAGGCACAGGCTTCTAGATATGGGCTTGGAACTAGCCCTAGAGGCTCCACACTGAGTAACCTTTTTGACCTTGAGGTTTTCAGCCAGAGAACACATTCACAATTCTGAACAGATGTCAAAAGAGACAGAGCTGAGATGACTCTTACCAGCATTGGCTTCCGAAGTCTATGTCTGGCTTTGAACTTTGAGTGTGAGACTTCATTCCCAAATGTTGGGTTGGAGCAGAGCTGGCTGACCATGAGGTTTCACCTCCATCATTGCAGGCTGGTGGGACTCTTCATATGCCAACAGCAAGTCTTTATGACTGAAAATAAGACCTCAGAGAGCCAGTGGGAAAGGCAGTGTGTTGGGCTTGAATTACAAGGAAACTGTGTGTGAGTAGCTTCCTGGAAGTCCTTAAAATATTTGCTTAAAAGCATAATAGCTTCCTGGAAGTCCTGAAAATATTTGCTTTTTCGGGGTATGCGTGTACGTGTGTGTGTGTGTGTGTGTGTGTGTGTGTGTGTGTGTGTAGGTAGGTGTGTCCACTAGAGATGGCACAGATCTACTTTTGGCCTAGGATTCAAAGCTGCTCTGTTAAGTTGAACTATTTCTTTTCTTTTTTTTTTTCTTTTTTTGAACTCTTTATTAGTGTAAGAATTTGAGTTGTCTTGCAGACCAAGTCTAGAACAGGTTTTCTTTAAAAACAAAAACAGGTGATCAAATGAGCAAACTTGGCAGCCAAACCTGGGAGGTGATATGGTAACAATTCTGTTATTGCTCAGAGTGTTTTGCAAATGCCAGTTTGCCTTCATACCAGTTCTCAAGCTAAATAAGAAAATCCACCTCGTTGCTTCTTTATAATCATGCTTTATATTTGTATGAAAATGAAAGTTGTCAGCCAAGGTTTTTTTTTTTTTTTCCAGAAAATTTAGCTCCAAGTGGCTTTTGGCTATTGACAAAGAACAGATAACATTTCAACAGCTAAAAATTGGTGCCCCAGATGGATAGTCAAGAAATAGAGCATCTGTAAAGTTGAGCAGAAAGAATCTAAATTCAGGTTCCTCCTACTTACTGTGAGATCTTCAGTAAGTTGCTTAACTTCTCTGAGCCTCAGTTTCTTTATCTGTGGAAAAGGATCATACCTACCTCATATCTACTGGTGTGGGTTTGAATTAAATGAAATACTGTATTTGTCTGACTTAATACATGTATCTTCTAGTATAACGAATATTAGTTTTTAAAAATCTGCTCCAAGCAGTTCCAAAAGAAAAGTCCTAAAATTGTTTTGGCCAGGTGATGTCATCTTTATTTTTATTTTTACTGATTTATTTTTTTCAGACAGAGTCTTGCTCTGTGGCCCAGGCTGGAGTGCAGTGGTGTGATCTCAGCTCACTGCAACCTCAGCCTCCCGGGTTCAAGTGCTGCTTCTTCTGCCTCAACCTCCCGAGTAGCTGGGATTATAGGTGCCCACCACCATGCCAGGCTAATTTTTGTATTTTTAGTAGAGACGAGGTTTCACCATGTTGGCCAGGCTGGTCTCGAACTTCTGACCTTCAGTGATCCCCCCGCCTCGGCCTCCCAAAGGGTTGAGATTACAGGCGTGAGCCCATCTTTTTAAATAAAAAAATTAGTTATTTAAAAATTTATGTCCAGTAAAATGTGCTATATTTAGTGTACAGTTCTGTGAGTTTTGACAAATGCATAGAGTTGTATACCCACAAACAAACACATCAAGATAAGAAAATTTCCATCACCACCCAAAATTCCCTTGTGCTGTTGCTTTGTCCTCAGTCCGTCCATGTGTTCTCTGGCAACCACTCATCTGTTCTCTGTCCCTCTGGTTTTACCTTTCCCAGCATGTAACATACATGGAATCATACAGTATGTAATTTTTTGAGTCTGGCTTATTTCACTCACCATATTGCATTTGAGAGATTCATCCACGTTGCCACGTGTCAATAGTTGCCTCCTTTTTATTGCTGAGTAGTATTCCATTGTATGGATGAACTACAATTTGTTTATCCTTCCCCCAGTTGAAAGATAATTGGGCTGTTTCCAGGTTTTGGCAACTATGAATAAGACTTCTATAAATGTTTACATGATTTTATATGAACAAAGTTTTCGTACGAACTTAAGTTTTCATTTTTCTTGTATAAATTTCTATGAGTAGATTGCTGGGTCAAATGGTAAATCTGTTTTCCAAAGTGGTGTGCCATTTTGCATTGTTATCAACAATGTGTAAGGCTTCCTGTTGTTCCATATCCTTGTCAACACTTGGTATATCCAGTCATTTTCATTATTTCATCATTCAAATCAAATAAGCATGTAGTGGTATCTTACTGCACTTTTTTTTTTTTTTCTTTTGAGACGGGGTCTTGCTCTTTCAGAAACCCAGGCAGGAGTGCAGTGGCACAGTCATAGCTCACTGCAACCTTGGACTTCTGGGCACAAGCAGTCCTCCTGCCTTAGCCTCCTGAGTGGCTGTGAACACAGGTGCATGCCACCATGCCTGGCAAATCACTGTGCTTTTAATTTGCTATTTCCTTAATGACTACTGATGTTAAGCATCTTTTAATATACTTATGTTCCTTTTGCATATGTTGTTTGTCCTTTTCTCATTGGGTTGTTCGTTTTCTTGCTTTTGAATTTGAGAGTTCCCTATATCTTCTGGATGCAAGTCCTTTGCCAGGTGCATGATTTGCAAGTGCTTTCTGTCATGTTGTAGATTGTTTTTTCAAAGCTTTCACAAGAAATTTATAAATACTTGTTCTTGTTATAAAATATTCAAATGACCCAGAAGTATTTAGAGTAAAAAGTACAAATTCTCTTTTACCTCCTATCCCTTCCTCCAGCTTTCTTCTCAGAGTTAGCCACCGTTGAATGTTTAGTGAGCATCTTTCCAGTCCTTTTTAAAAAAATATTTTTATGTGTATTTACATAGAGATGGTGTCTCACTCTATCACCCAGGCTGGGGAGCAGTGGAGTGATTATAGCTTGCCACAGCCTTGAACTCCTGGCCTTGTGAGCTACCATGCTCAACCTCAATTCTTTTTATGGCATCAGAATTTTCTGATAAATATATGTTTTGAAAGGGACATTTAAGTACTGATAGGTGTGCTTTAAAATTAATTGTATTACTCGACAGTCAATAAATTGCATTTCAAAGAATCTTCCGGTTTTTCCTTTCAGCCCAGTTATAGGTAAAATCATTGTTTTTATGTTAAAGTAGTGAGTTTTGATGTCCTGTGTCATATTGTAGAAAGCCATGATTTGGGGAAGAAAATTCCAGAAGATAAGGATGGCTGATGAGTGGATTAAATTTAAATAGGTCATTTTGTTTTATTTTATATATTTTTTAGAGATAAGGTCTCTCTCACTCTGTCGTCGCCCAGGTTGGAGTGCAGTGGCACGATCAAAGCTCACTGTCAAAAATAGGCCATTTATATTCACTAAAGATTGCTCTAATTAGTTGAAATGACTTTGAAATGTGTCCGTTTTCTTAAAATAAGTGGCAGGTTGCTCGTGTTTGTGTGATCTCTTTTAGCAAAGAATGATACCAGTAACCTCAGAGTAAAGTTCTGGCTCATTCCCAATTTTAGATTGATCATTTTTCTTTGATCGATTCTTTTGTACTGTTTGAAATACTCAGCACAGAATTTGCACTTGGTTTACATTTTTATTTTTAGCTCCAGTTTGCCTTTTTCAACCATAACTGGTCAGAACTCTTTTGCAGAGTGAGCCTTCTTAAGACAAGCTGTTTTTATCTTTCCATAGGTATGAATCCTAGGACCCAGAATAAGGATTCTCTAGAGGACAGTGTTTCTACCTCTCCAGACCCAAGTAAGAGGGGGCAGCTGACTGGGGAAAGGGGTAGACAGGGAGTGTGGGGTGGTCAGAGCATGAGGAAACAAGAGGAAGCCCTGTGGGAAGTGAGTGGTCCTGAGGTACACATACCTCTGGGGTATGGGAAGGCGATGTGGTGAGGGAGGACTCTCTGGACTCTGTGATGGAAAGTGAGGGGGTGTGTGACTGAATGACCTGTTTTGGAAGGTGATTCAGGGGCACCTGGGAAAGGTAGCAGATTCCCTATAAGGCCCCCATGCTGGTCCAGAGCTGGCCTTCACCCTTAACTGCCTAATGATATCTCCATGAAAAAGTTGGAAAGACATAATAGGCTGTTAACTGGAATCATTTACCTGCCTGTAGTTGAAATATTTGGCTGAATTGCATTCCTTTTGATTGTCTTTTTGAATAGCTATGCAGTAAGAGAATGTCTAAATATCTGTAATAATAAAATAGCAGAGAAAATCCTACCATTTGATAAACTTTACTTAGCTGTGACCAATGGATGTATATCACTGAGTCTTTTTGTCCCCACTTTTTTTTTTTTTTTTGAGACAGTGTCTTGCTCTGTCACCCAGGCTGGAGTGCAGTGACGTGATCTCGGCTCACTGCCACCTCTGCCTCCCAGGTTCAAGTGATTCTTCTGCCTCAGCCTCTTGAGTAGCTGGGATTATAGGCGCGCGCCACCACGCCTGGCTAATTTTTGTATTTTTAGTAGAGACGGGGTTTCACCATGTTGGTTAGGCTGGTCTCAAACTCCTAACCTCGTGATCCTGACCTCGTGATCCGCCCGCCTTGGCCTCCCAAAGTGCTGTGATTACAGCCGTGAGCCACCTCGCCCAGCCTTTGTCCCCACTTAATAATCCTTTTACTATTTGTTCAGGTCCCTCCTAGCAGTCATTTGTAATGGCAACATTAAGCATATTACTGTATCTTGGTTTGAGTAGTCATTTCTTATTCATGACCATTTGGATGGCTTTCTGCTTTTTAGCCATAGCATATAATGCAGCTATGATAATACCTGGTGGGCTGAGCATGGTGGCTCATGCCAGTAATCACAGAACTTTGGGAGGCTGAGGTGGGTGCTTCACTTGAGCCCAGGAGTTTGAGACCAGCCCGGGCAATATAGTGAGACCCTGTCTCTATTAAATTAGAAGTTAATAATAATACATAATACATGGTGCAGCAGGTGTATTTTTTCTTTTGGTTAATGTCTTTGGATTACACTCCCCAAAGTATGGTTGGCAGATTGACTATTTTCCAGAAAGCTACCAGCAGTGAATAGATGATTCTATTTCTCTACAACCCTGTCACCGGAGTTTGTTACCTTTGCTCATCATTGTTATTTTAGTGGTTCTGAGGTGTAGAACTTCCTCAGAGTCCCTCTTTTCAGAACCAGAAGATACTGGGGTTAGAAAAGAGGCTGCACTCTTTTCCTAGAGACAGAACACCCTTAAACTTACAATCAGGATCCTTTCTCATCATGAGATCTCGAACTAAGCATTTGAACAGTCTGTGTCTTGTTGTGTGCCCAGCAGAAAGCATTTCTACAAGATTTTTGTAATCCTGAGGGTCAGAAGGCTGATGATGGCCAGGATGATCTAAGAGGACATAAAGATAGATTTGTCTTCTGTTTCTGGCTTCCCCACTGGGGCTTTGATCAGGTCCTCATCTTCTGTTTTAGCCAGGAAGTAAAAACAAGCTCACCTTCTCGGCTGCCATATAGAAAAATGGAGATGATTAATTAGGCTATTCGGGCCTATGTTTTGGATTCCTGAATTATTAATGAGTTTATAAGGCCTGTGTAGAGCATGAATTAGATCTGTTGCAGGCTAAATCATCTTCCCCAAGTCAGTGGTGCCACGTGGGGCATCTTTCTGCTGTGACTTAGCACACAAATTTTGTTCTTCATTGACGGGAGGGCTGATGAGGCAGCAGGGGCTACAACACATTATAAGCTGTTAGCATGGTACAAAAATAAAGTGAGTATCCCATTCAGAACTTAGAGACAAACGCTCAGAGTTTTTCGGCTTCGTATTGCTCCCTTCTTTGGAAAGTTAAAAGATAGTCTTCACTTAAATTACTTAAAGAGGTAACTGCCCTATTATTTTAACTCAGTGAAGCTCAACCAGGGAGGATTTTCCTAACCAGGGAGGATTTCCCTCCCCCAGGGGAACATGTCAATGCCTGCAGACATTTCTGGTTTTCACAGCTAGGGGATGCCACTGGCATCTAGTGAGTAGAGTCCAAGGATGCTGCTGCGGTACCCAGGACAGCCCCCACAACAAAGAATTATCTGGTTCAAAGTCTCTGTTGTTGCCGAGGCTGAGAAACTCTGCTTTAACTGAGGAGCAGGCAATTCGGGACAGACCCATGTGGTCAGGACTGCTCTGCTAACTGCAGCCTTCATTTTTGGATTGTTAAAACTCTGTCTCTTAAAGTTCCAGCCTCCTAACTTTCCCAGATATCCTTACTTGATTTTTCCTCCCACCCTTTTGAATCTGTTACTTATTTTTGCAGTGCTAGAAGTATTCCTTATTT";
// largeurs des motifs
int[] mot1 = {1,2,4,8};
int[] mot2 = {8,16,24,32,64};
int indm1, indm2 = 0;

import processing.serial.*;

Serial myPort;  // The serial port
String val;
int lEchantillon, nbBandes, lTrou , p4;
boolean bSave, bTrou;

int pas=0;

//int lEchantillon = 8;
// nombre de bandes horizontales

// valeurs max des bandes
int[][] lesMotifs = new int[16][2];
int nMotif = 0;

int indp5 = 0;
int posX=0;
int posY = 0;

Motif m;

void setup() {
  nbBandes = 8;
  nbBandes = 1;
  frameRate(25);
  noStroke();
  // List all the available serial ports
  printArray(Serial.list());
  try {
    /* mbp par défaut
    [0] "/dev/cu.Bluetooth-Incoming-Port"
    [1] "/dev/cu.DOSSSoundBox-SerialPort-1"
    [2] "/dev/cu.usbmodem14201"
    [3] "/dev/tty.Bluetooth-Incoming-Port"
    [4] "/dev/tty.DOSSSoundBox-SerialPort-1"
    [5] "/dev/tty.usbmodem14201"
    */
    myPort = new Serial(this, Serial.list()[5], 19200);
    myPort.bufferUntil('\n');
    // demande l'envoie des valeurs des potards à l'init (arduino)
    myPort.write("\n");
  }
  catch(Exception e) { 
    println("vérifiez le cablage et les réglages de port... qlq chose fonctionne mal :°"); 
    e.printStackTrace();
  }
  /* taille et position de la fenêtre*/
  //size(1280,800);
  size(160,128);
  //positionne, le fichier
  surface.setLocation(displayWidth - 200, 100);
  //fullScreen();
  for (int i =0; i<nbBandes;i++) {
    faitMotif(i);
  }
  //changeMotif();
  println(float(height)/nbBandes,"longueur code: ",DP5.length());
}

void draw() {
  background(255);
  while(posY < height) {
    while(posX < width) { // rempli l'écran
      Motif m = litDP5(nMotif%nbBandes);
      fill(m.couleur);
      rect(posX, posY, m.largeur, m.hauteur);
      posX += m.largeur;
    }
    nMotif++;
    posY+= m.hauteur;
    posX = 0;
  }
  
  // réinitialise la position horizontale
  posX = 0;
  posY = 0;
  // a reactiver pour changer le motif à chaque image
  //changeMotif();
  pas++;
  if (bSave) {
    save("m_"+mot1[indm1]+"_"+mot2[indm2]+"_"+pas+".png");
    print("save:",bSave);
  }
  //println(m.hauteur,"motif:",mot1[indm1],mot2[indm2],"| pas: ",pas,"| progrs: ",int((float(pas*lEchantillon)/DP5.length())*100)+"% | reste:", DP5.length()-pas*lEchantillon);
  //println("| pas: ",pas,"| progrs: ",int((float(pas*lEchantillon)/DP5.length())*100)+"% | reste:", DP5.length()-pas*lEchantillon);
}

void changeMotif() {
  //genere x nouveaux paire de motifs
  println("nouveau lesMotifs: ");
  //pas=0;
  for (int i =0; i<nbBandes;i++) {
    faitMotif(i);
  }
}
void faitMotif(int id) {
  indm1 = int(random(0, mot1.length));
  indm2 = int(random(0, mot2.length));
  println("nouveau motif ",id,": ",mot1[indm1],mot2[indm2]);
  lesMotifs[id][0] = mot1[indm1];
  lesMotifs[id][1] = mot2[indm2];
}

// crée les motifs en fonction de la DP5 (code génétique)
Motif litDP5(int motifEncours) {
  switch (DP5.charAt(indp5%DP5.length())) {
    case 'A':
      // si la lettre suivante est un A, il crée un trou
      if (DP5.charAt((indp5%DP5.length())+1) == 'T' && DP5.charAt((indp5%DP5.length())+2) == 'T') {
        //println(DP5.charAt((indp5%DP5.length())+1),"trou");
         //float pour l'arrondi de la hauteur
        if (bTrou) {
          m = new Motif(255,lTrou,float(height)/nbBandes);
          indp5++;
        }
      } else {
        //println("non");
        //m = new Motif(0,mot1[indm1],float(height)/nbBandes);
        m = new Motif(0,lesMotifs[motifEncours][0],float(height)/nbBandes);
      }
      break;
    case 'T':
      m = new Motif(255,lesMotifs[motifEncours][0],float(height)/nbBandes);
      break;
    case 'G':
      m = new Motif(0,lesMotifs[motifEncours][1],float(height)/nbBandes);
      break;
    case 'C':
      m = new Motif(255,lesMotifs[motifEncours][1],float(height)/nbBandes);
      break;
    case ' ':
    default:
      m = new Motif(0,0,0);
      break;
  }
  indp5++;
  //indp5= indp5%lEchantillon;
  indp5= lEchantillon*pas + indp5%lEchantillon;
  //si en fin de code genetique, recommence depuis le debut sur une nouvelle image
  if (indp5>DP5.length()) {
    indp5 = 0;
    fill(200,0,0);
    circle(32,height/2, 16);
    posX=0;
    posY=0;
    pas =0;
    println("reset");
    changeMotif();
  }
  return m;
}

// classe motif
class Motif {
  int couleur;
  int hauteur;
  int largeur;
  
  Motif (int tC, int tL, float tH) {
    couleur = tC;
    // arrondi la valeur
    hauteur = round(tH);
    largeur = tL; 
  }
}

void serialEvent(Serial myPort) {
    loop();
    // read the serial buffer:
    String val = myPort.readStringUntil('\n');
    // enlève les espaces et RC
    val = trim(val);
    println(val);
    // explose la chaine sur le :
    String[] temp = split(val, ':');
    if (temp[0].equals("p1")) {
      lEchantillon = round(map(int(temp[1]),0,1022,8,32));
      println(temp[1]," - largeur échantillon:",lEchantillon);
    } else if (temp[0].equals("p2")) {
      nbBandes = round(map(int(temp[1]),0,1022,1,16));
      println(temp[1]," - nbr de bandes:",nbBandes);
    } else if (temp[0].equals("p3")) {
      lTrou = round(map(int(temp[1]),0,1022,1,int((width/2)/8)));
      lTrou*= 8;
      println(temp[1]," - largeur trou:",lTrou);
    } else if (temp[0].equals("p4")) {
      println(val);
      p4 = int(temp[1]);
    } else if (temp[0].equals("int1")) {
      bSave = boolean(int(temp[1]));
      println("interrupteur 1:",bSave);
    } else if (temp[0].equals("int2")) {
      bTrou = boolean(int(temp[1]));
      println("interrupteur 1:",bTrou);
    }
    indp5 = 0;
    fill(200,0,0);
    circle(32,height/2, 16);
    posX=0;
    posY=0;
    pas =0;
    changeMotif();
}
